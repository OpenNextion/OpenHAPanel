## components/ha_ws/Kconfig
```kconfig
menu "Home Assistant WebSocket SDK"

config HA_WS_TASK_STACK_SIZE
    int "WebSocket client task stack size"
    default 8192
    range 4096 32768
    help
        Stack size used by the WebSocket client task. TLS handshakes and JSON
        callbacks can exceed the esp_websocket_client default of 4096 bytes.

config HA_WS_RX_BUFFER_SIZE
    int "Maximum received JSON payload size"
    default 262144
    range 4096 1048576
    help
        Maximum size of one complete WebSocket text payload after fragmentation is assembled.
        Home Assistant get_states/get_services responses can easily exceed 8KB.

config HA_WS_TX_TIMEOUT_MS
    int "WebSocket send timeout in milliseconds"
    default 5000
    range 100 60000

endmenu
```
