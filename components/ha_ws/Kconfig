## components/ha_ws/Kconfig
```kconfig
menu "Home Assistant WebSocket SDK"

config HA_WS_TASK_STACK_SIZE
    int "WebSocket client task stack size"
    default 8192
    range 4096 32768
    help
        Stack size used by the WebSocket client task. TLS handshakes and JSON
        callbacks can exceed the esp_websocket_client default of 4096 bytes.

config HA_WS_MAX_PENDING
    int "Maximum pending commands"
    default 8
    range 1 32
    help
        Number of in-flight request/response commands tracked by the SDK.

config HA_WS_MAX_SUBSCRIPTIONS
    int "Maximum active subscriptions"
    default 8
    range 1 32
    help
        Number of long-lived Home Assistant event subscriptions tracked by the SDK.

config HA_WS_RX_BUFFER_SIZE
    int "Maximum received JSON payload size"
    default 262144
    range 4096 1048576
    help
        Maximum size of one complete WebSocket text payload after fragmentation is assembled.
        Home Assistant get_states/get_services responses can easily exceed 8KB.

config HA_WS_TX_TIMEOUT_MS
    int "WebSocket send timeout in milliseconds"
    default 5000
    range 100 60000

endmenu
```

## components/key/Kconfig
```kconfig
menu "IoT Button"

    config BUTTON_PERIOD_TIME_MS
        int "BUTTON PERIOD TIME (MS)"
        range 2 500
        default 25
        help
            "Button scan interval"

    config BUTTON_DEBOUNCE_TICKS
        int "BUTTON DEBOUNCE TICKS"
        range 1 7
        default 2
        help
            "One CONFIG_BUTTON_DEBOUNCE_TICKS equal to CONFIG_BUTTON_PERIOD_TIME_MS"

    config BUTTON_SHORT_PRESS_TIME_MS
        int "BUTTON SHORT PRESS TIME (MS)"
        range 50 3000
        default 2000

    config BUTTON_LONG_PRESS_TIME_MS
        int "BUTTON LONG PRESS TIME (MS)"
        range 500 10000
        default 10000

endmenu
```
